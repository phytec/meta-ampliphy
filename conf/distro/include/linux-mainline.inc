## conf/distro/securiphy-provisioning.conf
```bitbake
require conf/distro/poky.conf
require conf/distro/include/common.inc
require conf/distro/include/common-securiphy.inc

DISTRO = "securiphy-provisioning"
DISTRO_NAME = "securiPHY (The secure ampliPHY Vendor Distribution + Provisioning)"

INITRAMFS_IMAGE = "phytec-provisioning-initramfs"
INITRAMFS_IMAGE:k3 = "phytec-provisioning-initramfs"
```

## conf/distro/securiphy-vendor-provisioning.conf
```bitbake
require ampliphy-vendor.conf

DISTRO = "securiphy-vendor-provisioning"
DISTRO_NAME = "securiPHY Vendor (The secure ampliPHY Vendor Distribution + Provisioning)"

INITRAMFS_IMAGE = "phytec-provisioning-initramfs"
INITRAMFS_IMAGE:k3 = "phytec-provisioning-initramfs"

require conf/distro/include/common-securiphy.inc
```

## conf/distro/securiphy-vendor.conf
```bitbake
require ampliphy-vendor-rauc.conf

DISTRO = "securiphy-vendor"
DISTRO_NAME = "securiPHY Vendor (The secure ampliPHY Vendor Distribution)"

INITRAMFS_IMAGE = "phytec-secureboot-initramfs"

require conf/distro/include/common-securiphy.inc
```

## conf/distro/yogurt-ci.conf
```bitbake
require yogurt.conf

DISTRO = "yogurt-ci"
DISTRO_NAME = "Yogurt CI (Phytec CI Builds)"

PREFERRED_VERSION_linux-mainline_mx6ul = "4.19.y-phy%"
PREFERRED_VERSION_barebox = "master%"
SRCREV_pn-barebox = "${AUTOREV}"
SRCREV_pn-linux-mainline = "${AUTOREV}"
```

## conf/distro/yogurt-gateway.conf
```bitbake
require yogurt-wayland.conf

DISTRO = "yogurt-gateway"
DISTRO_NAME = "Yogurt Gateway (Phytec Gateway Distribution)"

DISTRO_FEATURES += "virtualization"
```

## conf/distro/yogurt-glibc.inc
```bitbake
PNBLACKLIST[libiconv] = "the glibc provided iconv library is used"

TARGET_OS = "linux"
TARGET_OS .= "${@['','-gnueabi'][bb.data.getVar('TARGET_ARCH',d,1) in ['arm', 'armeb']]}"

# perl has some problems, see http://bugs.openembedded.net/show_bug.cgi?id=1616
# [23:00] oxo: glibc (any version) on sparc does not like (repeat me) "-Os"

TARGET_LINK_HASH_STYLE = "${@['-Wl,--hash-style=gnu',''][bb.data.getVar('TARGET_ARCH',d,1) in ['mips', 'mipsel', 'mips64', 'mips64el']]}"
```

## conf/distro/yogurt-package-ipk.inc
```bitbake
INHERIT += "package_ipk"

EXTRAOPKGCONFIG = "opkg-config-base"

YOGURT_IPK_UPDATE_ALTERNATIVES ?= "update-alternatives-opkg"

DISTRO_UPDATE_ALTERNATIVES = "${YOGURT_IPK_UPDATE_ALTERNATIVES}"

# we need the same provider for opkg and u-a
PREFERRED_PROVIDER_virtual/update-alternatives-native ?= "opkg-utils-native"
PREFERRED_PROVIDER_virtual/update-alternatives = "opkg-utils"
VIRTUAL-RUNTIME_update-alternatives = "${YOGURT_IPK_UPDATE_ALTERNATIVES}"
```

## conf/distro/yogurt-rt.conf
```bitbake
require yogurt.conf

DISTRO = "yogurt-rt"
DISTRO_NAME = "Yogurt PREEMPT-RT (Phytec PREEMPT-RT Distribution)"

DISTRO_FEATURES += "preempt-rt"
```

## conf/distro/yogurt-secure.conf
```bitbake
require yogurt.conf

DISTRO = "yogurt-secure"
DISTRO_NAME = "Yogurt Secure (Phytec Base Secure Distribution)"

require common-secure.inc
```

## conf/distro/yogurt-tiny.conf
```bitbake
require conf/distro/poky-tiny.conf
require common.inc

DISTRO = "yogurt-tiny"
DISTRO_NAME = "Yogurt Tiny (Phytec Tiny Distribution)"

DISTRO_FEATURES += "tiny"

#fix for poky-tiny.conf upstream problem
PREFERRED_PROVIDER_virtual/kernel_ti33x = "linux-mainline"
PREFERRED_PROVIDER_virtual/kernel_mx6 = "linux-mainline"
PREFERRED_PROVIDER_virtual/kernel_mx6ul = "linux-mainline"
PREFERRED_PROVIDER_virtual/kernel_rk3288 = "linux-mainline"

PNBLACKLIST[phytec-headless-image] = "not buildable with yogurt-tiny use core-image-minimal"
PNBLACKLIST[phytec-qt5demo-image] = "not buildable with yogurt-tiny use core-image-minimal"

# common.inc overwrites poky-tiny settings, so we have to revert this to upstream
# poky-tiny
VIRTUAL-RUNTIME_dev_manager = "busybox-mdev"
VIRTUAL-RUNTIME_login_manager = "busybox"
VIRTUAL-RUNTIME_init_manager = "busybox"
VIRTUAL-RUNTIME_initscripts = "initscripts"
VIRTUAL-RUNTIME_keymaps = "keymaps"
DISTRO_FEATURES_BACKFILL_CONSIDERED += "sysvinit"
```

## conf/distro/yogurt-vendor-secure.conf
```bitbake
require yogurt-vendor.conf

DISTRO = "yogurt-vendor-secure"
DISTRO_NAME = "Yogurt Vendor (Phytec Vendor Distribution + Secure)"

require common-secure.inc
```

## conf/distro/yogurt-vendor-wayland.conf
```bitbake
require yogurt-vendor.conf

DISTRO = "yogurt-vendor-wayland"
DISTRO_NAME = "Yogurt Vendor wayland (Phytec Vendor Distribution)"

DISTRO_FEATURES += "wayland vulkan"
```

## conf/distro/yogurt-vendor-xwayland.conf
```bitbake
require yogurt-vendor.conf

DISTRO = "yogurt-vendor-xwayland"
DISTRO_NAME = "Yogurt Vendor xwayland (Phytec Vendor Distribution)"

DISTRO_FEATURES += "x11 wayland vulkan"
```

## conf/distro/yogurt-vendor.conf
```bitbake
require yogurt.conf

DISTRO = "yogurt-vendor"
DISTRO_NAME = "Yogurt Vendor (Phytec Vendor Distribution)"

DISTRO_FEATURES += "pam vendor"

PREFERRED_PROVIDER_virtual/kernel_mx6ul = "linux-imx"

PREFERRED_VERSION_gstreamer1.0_mx8m ?= "1.16.0.imx"
PREFERRED_VERSION_gstreamer1.0-plugins-bad_mx8m ?= "1.16.0.imx"
PREFERRED_VERSION_gstreamer1.0-plugins-base_mx8m ?= "1.16.0.imx"
PREFERRED_VERSION_gstreamer1.0-plugins-good_mx8m ?= "1.16.0.imx"
```

## conf/distro/yogurt-wayland.conf
```bitbake
require yogurt.conf

DISTRO = "yogurt-wayland"
DISTRO_NAME = "Yogurt Wayland (Phytec Wayland Distribution)"

DISTRO_FEATURES += "wayland"
```

## conf/distro/yogurt-x11.conf
```bitbake
require yogurt.conf

DISTRO = "yogurt-x11"
DISTRO_NAME = "Yogurt X11 (PHYTEC X11 Distribution)"

DISTRO_FEATURES += "x11"
```

## conf/distro/yogurt.conf
```bitbake
require conf/distro/poky.conf
require common.inc

DISTRO = "yogurt"
DISTRO_NAME = "Yogurt (Phytec Base Distribution)"

DISTRO_FEATURES_DEFAULT_remove = "argp irda pcmcia zeroconf x11"
DISTRO_FEATURES = "${DISTRO_FEATURES_DEFAULT} opengl systemd"
DISTRO_FEATURES_append_mx8 = " qtwidgets"
DISTRO_FEATURES_remove_mx6ul = "opengl"
```

## conf/distro/yogurt.inc
```bitbake
#@TYPE: Distribution
#@NAME: Angstrom 
#@DESCRIPTION: Release independent distribution configuration for Angstrom

# Preserve original DISTRO value
USERDISTRO := "${DISTRO}"
DISTRO = "yogurt"
DISTRO_NAME = "Yogurt"
DISTRO_VERSION ?= "PDMaster"

BUILDNAME = "Yogurt ${DISTRO_VERSION}"

TARGET_VENDOR = "-yogurt"
SDK_VENDOR = "-yogurtsdk"

# Yocto work around for missing ONLINE_PACKAGE_MANAGEMENT support
ONLINE_PACKAGE_MANAGEMENT = "full"

# Put links to sources in deploy/sources to make it easier for people to be GPL compliant
#INHERIT += "src_distribute_local"
SRC_DIST_LOCAL ?= "symlink"

# Can be "glibc", "musl" or "uclibc"
TCLIBC ?= "glibc"

# The things *libc can provide.
PREFERRED_PROVIDER_eglibc = "glibc"

PREFERRED_PROVIDER_virtual/gettext ??= "gettext"
PREFERRED_PROVIDER_linux-libc-headers-nativesdk = "linux-libc-headers-nativesdk"

require yogurt-${TCLIBC}.inc

# Set some java bits
DEFAULTJRE ?= "openjdk-7-jre"

#Set the default maintainer to angstrom-dev
MAINTAINER = "Phytec Developers <support@phytec.de>"

#use debian style naming
INHERIT += "debian"

#activate config checker
INHERIT += "sanity" 

#activate the blacklister
INHERIT += "blacklist"

#make devshell available as task
INHERIT += "devshell" 

#use angstrom source mirrors to combat 404s
INHERIT += "phytec-mirrors" 

#run QA tests on builds and packages and log them  
INHERIT += "insane"
QA_LOG = "1"

# Log information on images and packages
INHERIT += "buildhistory"
BUILDHISTORY_COMMIT = "1"

#run QA tests on recipes
#INHERIT += "recipe_sanity"

#have a shared state a.k.a package-staging2
INHERIT += "sstate"

YOGURT_PKG_FORMAT ?= "ipk"
require yogurt-package-${YOGURT_PKG_FORMAT}.inc

# MACHINE_KERNEL_PR if not defined can cause parsing failures
# since MACHINE_KERNEL_PR is used in PR assignments in some recipes
# (meta-ti comes to mind) which means when creating FILESPATH
# it will try to evaluate it and if its undefined then python
# will except
#
# so for machines which do not define it lets define it to be empty

MACHINE_KERNEL_PR ??= "r0"

# We don't want to keep OABI compat
ARM_KEEP_OABI = "0"

#Generate locales on the buildsystem instead of on the target. Speeds up first boot, set to "1" to enable
PREFERRED_PROVIDER_qemu-native = "qemu-native"
ENABLE_BINARY_LOCALE_GENERATION ?= "1"

# We only want to build UTF8 locales
LOCALE_UTF8_ONLY = "1"

#qemu has taken a dislike to armeb as well
ENABLE_BINARY_LOCALE_GENERATION_armeb = "0"

# Prelink images
INHERIT += "image-prelink"

#Name the generated images in a sane way
IMAGE_NAME = "${DISTRO_NAME}-${IMAGE_BASENAME}-${TCLIBC}-${YOGURT_PKG_FORMAT}-${DISTRO_VERSION}-${MACHINE}"
DEPLOY_DIR_IMAGE = "${DEPLOY_DIR}/images/${MACHINE}"

# Angstrom *always* has some form of release config, so error out if someone thinks he knows better 
DISTRO_CHECK := "${@bb.data.getVar("DISTRO_VERSION",d,1) or bb.fatal('Remove this line or set a dummy DISTRO_VERSION if you really want to build an unversioned distro')}"

# We want images supporting the following features (for packagegroup(-core)-base)
DISTRO_FEATURES = "alsa argp bluetooth ext2 ipv4 ipv6 irda largefile nfs pam pci pcmcia ppp smbfs systemd usbgadget usbhost vfat wifi xattr zeroconf"

# Disable sysvinit for recipes with systemd support
DISTRO_FEATURES_BACKFILL_CONSIDERED += "sysvinit"
VIRTUAL-RUNTIME_init_manager = "systemd"
# Uncomment to completely disable support for sysv scripts:
#PACKAGECONFIG_pn-systemd = "xz"

# USE-flag like features
DISTRO_FEATURES += "tk"
DISTRO_FEATURES += "x11"
DISTRO_FEATURES += "3g"
DISTRO_FEATURES += "pulseaudio"

# OpenGL support
DISTRO_FEATURES += "opengl"
PREFERRED_PROVIDER_virtual/libgl ?= "mesa-gl"

# Inherit the default LIBC features superset from OE-core
DISTRO_FEATURES += "${DISTRO_FEATURES_LIBC}"

# Yocto tweaks
require yogurt-core-tweaks.inc
```

## conf/local.conf.sample
```bitbake
BB_NUMBER_THREADS ?= "${@oe.utils.cpu_count()}"
PARALLEL_MAKE ?= "-j ${@oe.utils.cpu_count()}"
MACHINE ?= "phyflex-am335x-1"
#MACHINE ?= "phycore-am335x-1"
PREFERRED_PROVIDER_virtual/mesa = "mesa"
PREFERRED_PROVIDER_virtual/libgl = "mesa"
#MULTI_PROVIDER_WHITELIST += "virtual/mesa virtual/libgl"
IMAGE_INSTALL_remove = "packagegroup-gnome-apps"
TCLIBC = "glibc"
#PREFERRED_PROVIDER_virtual/libintl = "eglibc"
PREFERRED_PROVIDER_virtual/libc = "glibc"
PREFERRED_PROVIDER_eglibc = "glibc"
DL_DIR ?= "/media/data/yocto-downloads"
SSTATE_DIR ?= "/media/data/yocto-sstate/1.7"
DEPLOY_DIR = "${TOPDIR}/deploy"
TMPDIR = "${TOPDIR}/tmp"
DISTRO ?= "angstrom-next"
PACKAGE_CLASSES ?= "package_ipk"
SDKMACHINE ?= "x86_64"
EXTRA_IMAGE_FEATURES = "debug-tweaks"
USER_CLASSES ?= "buildstats image-mklibs image-prelink"
#TEST_IMAGE = "1"
OE_TERMINAL = "auto"
PATCHRESOLVE = "noop"
BB_DISKMON_DIRS = "\
    STOPTASKS,${TMPDIR},1G,100K \
    STOPTASKS,${DL_DIR},1G,100K \
    STOPTASKS,${SSTATE_DIR},1G,100K \
    ABORT,${TMPDIR},100M,1K \
    ABORT,${DL_DIR},100M,1K \
    ABORT,${SSTATE_DIR},100M,1K" 
#SSTATE_MIRRORS ?= "\
#file://.* http://someserver.tld/share/sstate/PATH;downloadfilename=PATH \n \
#file://.* file:///some/local/dir/sstate/PATH"
PACKAGECONFIG_append_pn-qemu-native = " sdl"
PACKAGECONFIG_append_pn-nativesdk-qemu = " sdl"
ASSUME_PROVIDED += "libsdl-native"
CONF_VERSION = "1"
#CCACHE = "ccache"
#INHERIT += "ccache"
#CCACHE_DIR = "/home/mueller-klieser/.ccache"
#CCACHE_DISABLE = "0"
```

## conf/machine/containerarm.conf
```bitbake
require conf/machine/qemuarm.conf

PREFERRED_PROVIDER_virtual/kernel = "linux-dummy"

MACHINE_ESSENTIAL_EXTRA_RDEPENDS = ""
```

## conf/machine/containerarm64.conf
```bitbake
require conf/machine/qemuarm64.conf

PREFERRED_PROVIDER_virtual/kernel = "linux-dummy"

MACHINE_ESSENTIAL_EXTRA_RDEPENDS = ""
```
