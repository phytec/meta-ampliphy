## conf/distro/securiphy.conf
```bitbake
require ampliphy-rauc.conf

DISTRO = "securiphy"
DISTRO_NAME = "securiPHY (The secure ampliPHY Distribution)"

INITRAMFS_IMAGE = "phytec-secureboot-initramfs"
INITRAMFS_IMAGE:k3 = "phytec-secureboot-initramfs"

require conf/distro/include/common-securiphy.inc

DISTRO_FEATURES:append = " ssh-authentication ssh-hardening"

UBOOT_DISABLE_CONSOLE ?= "1"
SERIAL_CONSOLES = ""
```

## conf/layer.conf
```bitbake
# We have a conf and classes directory, append to BBPATH
BBPATH .= ":${LAYERDIR}"

# We have a recipes directory, add to BBFILES
BBFILES += "${LAYERDIR}/recipes*/*/*.bb ${LAYERDIR}/recipes*/*/*.bbappend"

BBFILE_COLLECTIONS += "ampliphy"
BBFILE_PATTERN_ampliphy := "^${LAYERDIR}/"
BBFILE_PRIORITY_ampliphy = "10"

LICENSE_PATH += "${LAYERDIR}/licenses"
CERT_PATH ??= "${TOPDIR}/../phytec-dev-ca"
CYCLONEDX_LAYERDIR = "${LAYERDIR}"

# Layer dependencies
LAYERDEPENDS_ampliphy = "phytec openembedded-layer networking-layer meta-python multimedia-layer rauc"
LAYERSERIES_COMPAT_ampliphy = "wrynose"

# only activates content when identified layers are present,
# to ensure yocto compatibility check pass
BBFILES_DYNAMIC += " \
    fsl-bsp-release:${LAYERDIR}/dynamic-layers/fsl-bsp-release/recipes-*/*/*.bb \
    fsl-bsp-release:${LAYERDIR}/dynamic-layers/fsl-bsp-release/recipes-*/*/*.bbappend \
    fsl-sdk-release:${LAYERDIR}/dynamic-layers/fsl-sdk-release/recipes-*/*/*.bb \
    fsl-sdk-release:${LAYERDIR}/dynamic-layers/fsl-sdk-release/recipes-*/*/*.bbappend \
    meta-ti-bsp:${LAYERDIR}/dynamic-layers/meta-ti-bsp/recipes-*/*/*.bb \
    meta-ti-bsp:${LAYERDIR}/dynamic-layers/meta-ti-bsp/recipes-*/*/*.bbappend \
    meta-ti-extras:${LAYERDIR}/dynamic-layers/meta-ti-extras/recipes-*/*/*.bb \
    meta-ti-extras:${LAYERDIR}/dynamic-layers/meta-ti-extras/recipes-*/*/*.bbappend \
    gstreamer1.0:${LAYERDIR}/dynamic-layers/gstreamer1.0/recipes-*/*/*.bb \
    gstreamer1.0:${LAYERDIR}/dynamic-layers/gstreamer1.0/recipes-*/*/*.bbappend \
    meta-arago-distro:${LAYERDIR}/dynamic-layers/meta-arago-distro/recipes-*/*/*.bb \
    meta-arago-distro:${LAYERDIR}/dynamic-layers/meta-arago-distro/recipes-*/*/*.bbappend \
    meta-arago-extras:${LAYERDIR}/dynamic-layers/meta-arago-extras/recipes-*/*/*.bb \
    meta-arago-extras:${LAYERDIR}/dynamic-layers/meta-arago-extras/recipes-*/*/*.bbappend \
    meta-arago-test:${LAYERDIR}/dynamic-layers/meta-arago-test/recipes-*/*/*.bb \
    meta-arago-test:${LAYERDIR}/dynamic-layers/meta-arago-test/recipes-*/*/*.bbappend \
    virtualization-layer:${LAYERDIR}/dynamic-layers/meta-virtualization/recipes-*/*/*.bb \
    virtualization-layer:${LAYERDIR}/dynamic-layers/meta-virtualization/recipes-*/*/*.bbappend \
    tpm-layer:${LAYERDIR}/dynamic-layers/tpm-layer/recipes-*/*/*.bb \
    tpm-layer:${LAYERDIR}/dynamic-layers/tpm-layer/recipes-*/*/*.bbappend \
    meta-arm:${LAYERDIR}/dynamic-layers/meta-arm/recipes-*/*/*.bb \
    meta-arm:${LAYERDIR}/dynamic-layers/meta-arm/recipes-*/*/*.bbappend \
    chromium-browser-layer:${LAYERDIR}/dynamic-layers/chromium-browser-layer/recipes-*/*/*.bb \
    chromium-browser-layer:${LAYERDIR}/dynamic-layers/chromium-browser-layer/recipes-*/*/*.bbappend \
    meta-freescale-ml:${LAYERDIR}/dynamic-layers/meta-freescale-ml/recipes-*/*/*.bb \
    meta-freescale-ml:${LAYERDIR}/dynamic-layers/meta-freescale-ml/recipes-*/*/*.bbappend \
    imx-machine-learning:${LAYERDIR}/dynamic-layers/imx-machine-learning/recipes-*/*/*.bb \
    imx-machine-learning:${LAYERDIR}/dynamic-layers/imx-machine-learning/recipes-*/*/*.bbappend \
    meta-hailo-accelerator:${LAYERDIR}/dynamic-layers/meta-hailo-accelerator/recipes-*/*/*.bb \
    meta-hailo-accelerator:${LAYERDIR}/dynamic-layers/meta-hailo-accelerator/recipes-*/*/*.bbappend \
    meta-hailo-libhailort:${LAYERDIR}/dynamic-layers/meta-hailo-libhailort/recipes-*/*/*.bb \
    meta-hailo-libhailort:${LAYERDIR}/dynamic-layers/meta-hailo-libhailort/recipes-*/*/*.bbappend \
    meta-hailo-tappas:${LAYERDIR}/dynamic-layers/meta-hailo-tappas/recipes-*/*/*.bb \
    meta-hailo-tappas:${LAYERDIR}/dynamic-layers/meta-hailo-tappas/recipes-*/*/*.bbappend \
"
# layerrecommends need to be in sync with dynamic layers
# if not, the layer index will throw parsing errors
LAYERRECOMMENDS_ampliphy = "\
    fsl-bsp-release \
    fsl-sdk-release \
    meta-ti-bsp \
    meta-ti-extras \
    gstreamer1.0 \
    meta-arago-distro \
    meta-arago-extras \
    meta-arago-test \
    virtualization-layer \
    tpm-layer \
    meta-arm \
    chromium-browser-layer \
    meta-freescale-ml \
    imx-machine-learning \
    meta-hailo-accelerator \
    meta-hailo-libhailort \
    meta-hailo-tappas \
"
```
