## conf/distro/securiphy.conf
```bitbake
require ampliphy-rauc.conf

DISTRO = "securiphy"
DISTRO_NAME = "securiPHY (The secure ampliPHY Distribution)"

INITRAMFS_IMAGE = "phytec-secureboot-initramfs"
INITRAMFS_IMAGE:k3 = "phytec-secureboot-initramfs"
INITRAMFS_IMAGE:mx6-generic-bsp = "${@bb.utils.contains('MACHINE_FEATURES', 'emmc', 'phytec-secureboot-initramfs', '', d)}"

require conf/distro/include/common-securiphy.inc

DISTRO_FEATURES:append = " ssh-authentication ssh-hardening"

UBOOT_DISABLE_CONSOLE ?= "1"
SERIAL_CONSOLES = ""

require conf/distro/include/common-cyclonedx.inc
```
