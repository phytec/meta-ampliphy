## conf/bblayers.conf.sample
```bitbake
# LAYER_CONF_VERSION is increased each time build/conf/bblayers.conf
# changes incompatibly
LCONF_VERSION = "5"

BBPATH = "${TOPDIR}"
BBFILES ?= ""

BBLAYERS ?= " \
  ${TOPDIR}/../sources/poky/meta-yocto \
  ${TOPDIR}/../sources/poky/meta \
  /home/mueller-klieser/meta-phydev \
  ${TOPDIR}/../sources/meta-phytec/meta-phyam335x \
  ${TOPDIR}/../sources/meta-phytec \
  ${TOPDIR}/../sources/meta-yogurt \
  ${TOPDIR}/../sources/meta-openembedded/meta-oe \
  ${TOPDIR}/../sources/meta-openembedded/meta-systemd \
  ${TOPDIR}/../sources/meta-openembedded/meta-gnome \
  ${TOPDIR}/../sources/meta-openembedded/meta-gpe \
  ${TOPDIR}/../sources/meta-angstrom \
"

BBLAYERS_NON_REMOVABLE ?= " \
  ${TOPDIR}/../sources/poky/meta \
  ${TOPDIR}/../sources/poky/meta-yocto \
"

#  ${TOPDIR}/../sources/meta-ti \
#  ${TOPDIR}/../sources/meta-qt5 \
#
#  /media/data/yocto/sources/poky/meta-yocto-bsp \
#
```

## conf/distro/ampliphy-gateway.conf
```bitbake
require ampliphy-wayland.conf

DISTRO = "ampliphy-gateway"
DISTRO_NAME = "ampliPHY Gateway (Phytec Gateway Distribution)"

DISTRO_FEATURES += "virtualization"
```

## conf/distro/ampliphy-linux-mainline.conf
```bitbake
require conf/distro/poky.conf
require conf/distro/include/common.inc
require conf/distro/include/linux-mainline.inc

DISTRO = "ampliphy-linux-mainline"
DISTRO_NAME = "ampliPHY linux-mainline"
```

## conf/distro/ampliphy-provisioning.conf
```bitbake
require ampliphy.conf

DISTRO = "ampliphy-provisioning"
DISTRO_NAME = "ampliPHY (Phytec Base Distribution + Secure + Provisioning)"

require common-secure.inc
```

## conf/distro/ampliphy-rauc.conf
```bitbake
require conf/distro/include/common.inc
require conf/distro/include/common-rauc.inc

DISTRO = "ampliphy-rauc"
DISTRO_NAME = "ampliPHY RAUC (Phytec Base Distribution + RAUC)"
```

## conf/distro/ampliphy-rt.conf
```bitbake
require conf/distro/poky.conf
require conf/distro/include/common.inc

DISTRO = "ampliphy-rt"
DISTRO_NAME = "ampliPHY PREEMPT-RT (Phytec PREEMPT-RT Distribution)"

DISTRO_FEATURES += "preempt-rt"

# Features enabled by virtualization can have potential negative impact on RT latencies.
DISTRO_FEATURES:remove:k3 = "virtualization"
```

## conf/distro/ampliphy-secure.conf
```bitbake
require ampliphy-rauc.conf

DISTRO = "ampliphy-secure"
DISTRO_NAME = "ampliPHY Secure (Phytec Base Secure Distribution)"

require common-secure.inc
```

## conf/distro/ampliphy-vendor-provisioning.conf
```bitbake
require ampliphy-vendor.conf

DISTRO = "ampliphy-vendor-provisioning"
DISTRO_NAME = "ampliPHY Vendor (Phytec Vendor Distribution + Secure + Provisioning)"

require common-secure.inc
```

## conf/distro/ampliphy-vendor-rauc.conf
```bitbake
require ampliphy-vendor.conf

DISTRO = "ampliphy-vendor-rauc"
DISTRO_NAME = "ampliPHY Vendor (Phytec Vendor Distribution + RAUC)"

require conf/distro/include/common-rauc.inc
```

## conf/distro/ampliphy-vendor-rt.conf
```bitbake
require ampliphy-vendor.conf

DISTRO = "ampliphy-vendor-rt"
DISTRO_NAME = "ampliPHY Vendor PREEMPT-RT (Phytec Vendor PREEMPT-RT Distribution)"

DISTRO_FEATURES += "preempt-rt"

# Features enabled by virtualization can have potential negative impact on RT latencies.
DISTRO_FEATURES:remove:k3 = "virtualization"
```

## conf/distro/ampliphy-vendor-secure.conf
```bitbake
require ampliphy-vendor.conf

DISTRO = "ampliphy-vendor-secure"
DISTRO_NAME = "ampliPHY Vendor (Phytec Vendor Distribution + Secure)"

require common-secure.inc
```

## conf/distro/ampliphy-vendor-wayland.conf
```bitbake
require ampliphy-vendor.conf

DISTRO = "ampliphy-vendor-wayland"
DISTRO_NAME = "ampliPHY Vendor wayland (Phytec Vendor Distribution)"

DISTRO_FEATURES += "wayland vulkan"
```

## conf/distro/ampliphy-vendor-xwayland.conf
```bitbake
require ampliphy-vendor.conf

DISTRO = "ampliphy-vendor-xwayland"
DISTRO_NAME = "ampliPHY Vendor xwayland (Phytec Vendor Distribution)"

DISTRO_FEATURES += "x11 wayland vulkan"
```

## conf/distro/ampliphy-vendor.conf
```bitbake
require conf/distro/include/common.inc

DISTRO = "ampliphy-vendor"
DISTRO_NAME = "ampliPHY Vendor (Phytec Vendor Distribution)"

DISTRO_FEATURES += "pam vendor"

PREFERRED_VERSION_gstreamer1.0:mx8m-generic-bsp ?= "1.24.7.imx"
PREFERRED_VERSION_gstreamer1.0-plugins-bad:mx8m-generic-bsp ?= "1.24.7.imx"
PREFERRED_VERSION_gstreamer1.0-plugins-base:mx8m-generic-bsp ?= "1.24.7.imx"
PREFERRED_VERSION_gstreamer1.0-plugins-good:mx8m-generic-bsp ?= "1.24.7.imx"
PREFERRED_VERSION_gstreamer1.0-plugins-good-qt:mx8m-generic-bsp = "1.24.7.imx"
PREFERRED_VERSION_gstreamer1.0-libav:mx8m-generic-bsp       = "1.24.0.imx"

PREFERRED_VERSION_gstreamer1.0:mx8x-nxp-bsp ?= "1.24.7.imx"
PREFERRED_VERSION_gstreamer1.0-plugins-bad:mx8x-nxp-bsp ?= "1.24.7.imx"
PREFERRED_VERSION_gstreamer1.0-plugins-base:mx8x-nxp-bsp ?= "1.24.7.imx"
PREFERRED_VERSION_gstreamer1.0-plugins-good:mx8x-nxp-bsp ?= "1.24.7.imx"
PREFERRED_VERSION_gstreamer1.0-plugins-good-qt:mx8x-nxp-bsp ?= "1.24.7.imx"
PREFERRED_VERSION_gstreamer1.0-libav:mx8x-nxp-bsp ?= "1.24.0.imx"

PREFERRED_VERSION_gstreamer1.0:mx93-generic-bsp ?= "1.24.7.imx"
PREFERRED_VERSION_gstreamer1.0-plugins-bad:mx93-generic-bsp ?= "1.24.7.imx"
PREFERRED_VERSION_gstreamer1.0-plugins-base:mx93-generic-bsp ?= "1.24.7.imx"
PREFERRED_VERSION_gstreamer1.0-plugins-good:mx93-generic-bsp ?= "1.24.7.imx"
PREFERRED_VERSION_gstreamer1.0-plugins-good-qt:mx93-generic-bsp ?= "1.24.7.imx"
PREFERRED_VERSION_gstreamer1.0-libav:mx93-generic-bsp ?= "1.24.0.imx"

PREFERRED_VERSION_libcamera:mx95-generic-bsp ?= "0.3.0.imx"
```

## conf/distro/ampliphy-wayland.conf
```bitbake
require ampliphy.conf

DISTRO = "ampliphy-wayland"
DISTRO_NAME = "ampliPHY Wayland (Phytec Wayland Distribution)"

DISTRO_FEATURES += "wayland"
```

## conf/distro/ampliphy-x11.conf
```bitbake
require ampliphy.conf

DISTRO = "ampliphy-x11"
DISTRO_NAME = "ampliPHY X11 (PHYTEC X11 Distribution)"

DISTRO_FEATURES += "x11"
```

## conf/distro/ampliphy-xwayland.conf
```bitbake
require ampliphy.conf

DISTRO = "ampliphy-xwayland"
DISTRO_NAME = "ampliPHY XWayland (Phytec XWayland Distribution)"

DISTRO_FEATURES += "x11 wayland pam"
```

## conf/distro/ampliphy.conf
```bitbake
require conf/distro/poky.conf
require conf/distro/include/common.inc

DISTRO = "ampliphy"
DISTRO_NAME = "ampliPHY (Phytec Base Distribution)"

INITRAMFS_IMAGE:k3 = "phytec-initramfs-image"
```

## conf/distro/common-rauc.inc
```bitbake
# Add distro feature rauc. The OVERRIDE must be named differently, as there is
# already a package with the same name.
DISTRO_FEATURES:append = " rauc"
DISTROOVERRIDES:append = ":update"

# Reactivate sanity checks from meta-rauc
SKIP_META_RAUC_FEATURE_CHECK = "0"
```

## conf/distro/common-secure.inc
```bitbake
#add secure boot to the Distro
DISTRO_FEATURES:append = " secureboot"
DISTRO_FEATURES_NATIVE:append = " secureboot"
DISTRO_FEATURES_NATIVESDK:append = " secureboot"
OVERRIDES:append = ":secureboot"

#kernel-modsign
DISTRO_FEATURES:append = " kernelmodsign"
DISTRO_FEATURES_NATIVE:append = " kernelmodsign"
DISTRO_FEATURES_NATIVESDK:append = " kernelmodsign"
OVERRIDES:append = ":kernelmodsign"

#add protection shield level
#shieldlow - shieldmedium - shieldhigh
DISTRO_FEATURES:append = " protectionshield"
PROTECTION_SHIELD_LEVEL = "shieldlow"
OVERRIDES:append = ":protectionshield:${PROTECTION_SHIELD_LEVEL}"
#user root password for shield low and midle
#password quality decide about the protection level
PROTECTION_SHIELD_ROOT_PASSWORD ?= 'root'
# encrypted password for root
PROTECTION_SHIELD_ROOT_ENCRYPTED_PASSWORD ?= 'PI9ZxRHV.sgB6'

# Hardening Lite for kernel config
DISTRO_FEATURES:append:mx6 = " hardening"
DISTRO_FEATURES:append:mx6ul = " hardening"
DISTRO_FEATURES:append:mx8m = " hardening"
OVERRIDES:append = ":hardening"
# Deselect some kernel features that aren't always needed in ampliphy- secure
KERNEL_FEATURES_DESELECT ?= "debug kvm media xen"

# File system encryption
DISTRO_FEATURES += "securestorage"
# possible values: fileauthorenc , fileauthandenc
SECURE_STORAGE_TYPE ??= "fileauthandenc"
OVERRIDES:append = ":securestorage:${SECURE_STORAGE_TYPE}"

# Enable experimental OP-TEE support
MACHINE_FEATURES:append:mx8mm = " optee"
MACHINE_FEATURES:append:mx8mn = " optee"
MACHINE_FEATURES:append:mx8mp = " optee"

#add class secureboot for signing Bootloader and FIT-Image
INHERIT += "secureboot"
```

## conf/distro/common.inc
```bitbake
DISTRO_VERSION ??= "UNASSIGNED"
DISTRO_VERSION:mx6-generic-bsp = "BSP-Yocto-Ampliphy-i.MX6-PD22.1.1"
DISTRO_VERSION:mx6ul-generic-bsp = "BSP-Yocto-Ampliphy-i.MX6UL-PD22.1.1"
DISTRO_VERSION:mx7-nxp-bsp = "BSP-Yocto-NXP-i.MX7-PD23.1.2"
DISTRO_VERSION:mx8mp-mainline-bsp = "BSP-Yocto-Ampliphy-i.MX8MP-kirkstone"
DISTRO_VERSION:mx8mm-nxp-bsp = "BSP-Yocto-NXP-i.MX8MM-PD23.1.0"
DISTRO_VERSION:mx8mn-nxp-bsp = "BSP-Yocto-NXP-i.MX8MM-PD23.1.0"
DISTRO_VERSION:mx8mp-nxp-bsp = "BSP-Yocto-NXP-i.MX8MP-PD23.1.0"
DISTRO_VERSION:mx8x-nxp-bsp = "BSP-Yocto-NXP-i.MX8X-kirkstone"
DISTRO_VERSION:ti33x = "BSP-Yocto-Ampliphy-AM335x-PD23.1.0"
DISTRO_VERSION:rk3288 = "BSP-Yocto-Ampliphy-RK3288-kirkstone"
DISTRO_VERSION:am57xx = "BSP-Yocto-Ampliphy-AM57x-PD24.1.0"
DISTRO_VERSION:am62xx = "BSP-Yocto-Ampliphy-AM62x-PD23.2.1"
DISTRO_VERSION:am62axx = "BSP-Yocto-Ampliphy-AM62Ax-PD23.1.1"
DISTRO_VERSION:am64xx = "BSP-Yocto-Ampliphy-AM64x-PD23.2.1"
DISTRO_VERSION:k3r5-am62xx = "${DISTRO_VERSION:am62xx}"
DISTRO_VERSION:k3r5-am62axx = "${DISTRO_VERSION:am62axx}"
DISTRO_VERSION:k3r5-am64xx = "${DISTRO_VERSION:am64xx}"
DISTRO_VERSION:j721s2 = "BSP-Yocto-Ampliphy-AM68x-PD24.1.0"
VENDOR = "phytec"
TARGET_VENDOR = "-${VENDOR}"

# The bundle version interacts with the downgrade barrier.
# "r0" as version, disables the downgrade barrier. If a
# downgrade barrier is set with r1, you have to increase
# the version for every update. In that way old security
# vulnerabilities cannot be exploited.
RAUC_BUNDLE_VERSION ?= "r0"

SDK_VENDOR = "-${VENDOR}sdk"
SDK_VERSION := "${DISTRO_VERSION}"
SDK_NAME = "${VENDOR}-${DISTRO}-${TCLIBC}-${SDK_ARCH}-${IMAGE_BASENAME}-${TUNE_PKGARCH}"
SDKPATH = "/opt/${VENDOR}-${DISTRO}/${SDK_VERSION}"

#activate config checker
INHERIT += "sanity"

#we provide source mirrors for missing packages
INHERIT += "phytec-mirrors"

#run QA tests on builds and packages and log them
INHERIT += "insane"
QA_LOG = "1"

# Log information on images and packages
INHERIT += "buildhistory"
# Uncomment to disable commits
#BUILDHISTORY_COMMIT = "0"
INHERIT += "buildstats"

# Create /etc/build
INHERIT += "image-buildinfo"
IMAGE_BUILDINFO_VARS:append = " DATETIME DISTRO_NAME IMAGE_BASENAME MACHINE TUNE_PKGARCH"
IMAGE_BUILDINFO_VARS:append = " MACHINE_FEATURES DISTRO_FEATURES IMAGE_FEATURES"

#run QA tests on recipes
#INHERIT += "recipe_sanity"

PACKAGE_CLASSES ?= "package_ipk"

# All images build with the distribution get the version package
IMAGE_INSTALL:append = " os-release"
PREFERRED_PROVIDER_os-release = "ampliphy-version"

# Move listet checks from ERROR_QA to WARN_QA (defined in insane.bbclass)
ERROR_TO_WARN_QA = "version-going-backwards"
ERROR_QA:remove = "${ERROR_TO_WARN_QA}"
WARN_QA:append = " ${ERROR_TO_WARN_QA}"

# suppress meta-virtualization useless warning when building
# without virtualization distro feature
SKIP_META_VIRT_SANITY_CHECK = "1"

# Suppress meta-rauc warning when building without rauc distro feature. We only
# activate this distro feature when needed in distros tailored for this
# use-case.
SKIP_META_RAUC_FEATURE_CHECK = "1"

VIRTUAL-RUNTIME_dev_manager = "udev"
VIRTUAL-RUNTIME_init_manager = "systemd"
DISTRO_FEATURES_BACKFILL_CONSIDERED += "sysvinit"
VIRTUAL-RUNTIME_login_manager = "busybox"
VIRTUAL-RUNTIME_syslog = ""
VIRTUAL-RUNTIME_initscripts = ""

# some default locales
IMAGE_LINGUAS ?= "de-de fr-fr en-us"

# Define Country Code for Laird LWB WiFi chips.
# Possible Codes: US/CA/ETSI/JP/AU/CN/TW/BR/KR
# ETSI includes all member countries of the European Union.
#LWB_REGDOMAIN = "US"

PREFERRED_VERSION_mraa = "2.0.%"

# default value in bitbake.conf of poky is '/home/root'
# change to '/root' as this is preferred path
ROOT_HOME ?= "/root"
```

## conf/distro/include/common-rauc.inc
```bitbake
# Add distro feature rauc. The OVERRIDE must be named differently, as there is
# already a package with the same name.
DISTRO_FEATURES:append = " rauc"
DISTROOVERRIDES:append = ":update"

# Reactivate sanity checks from meta-rauc
SKIP_META_RAUC_FEATURE_CHECK = "0"

# Align rootfs to 4 kiB blocks to support "block-hash-index" adapative updates
IMAGE_ROOTFS_ALIGNMENT = "4"

# Activate redundant application slots
#DISTRO_FEATURES += "rauc-appfs"
#DISTROOVERRIDES:append = ":rauc-appfs"
```

## conf/distro/include/common-securiphy.inc
```bitbake
#add secure boot to the Distro
DISTRO_FEATURES:append = " secureboot"
DISTRO_FEATURES_NATIVE:append = " secureboot"
DISTRO_FEATURES_NATIVESDK:append = " secureboot"
DISTROOVERRIDES:append = ":secureboot"

#kernel-modsign
DISTRO_FEATURES:append = " kernelmodsign"
DISTRO_FEATURES_NATIVE:append = " kernelmodsign"
DISTRO_FEATURES_NATIVESDK:append = " kernelmodsign"
DISTROOVERRIDES:append = ":kernelmodsign"

#add protection shield level
#shieldlow - shieldmedium - shieldhigh
DISTRO_FEATURES:append = " protectionshield"
PROTECTION_SHIELD_LEVEL = "shieldlow"
DISTROOVERRIDES:append = ":protectionshield:${PROTECTION_SHIELD_LEVEL}"
#user root password for shield low and midle
#password quality decide about the protection level
PROTECTION_SHIELD_ROOT_PASSWORD ?= 'root'
# encrypted password for root
PROTECTION_SHIELD_ROOT_ENCRYPTED_PASSWORD ?= 'PI9ZxRHV.sgB6'

# Hardening Lite for kernel config
DISTRO_FEATURES:append:mx6-generic-bsp = " hardening"
DISTRO_FEATURES:append:mx6ul-generic-bsp = " hardening"
DISTRO_FEATURES:append:mx8m-nxp-bsp = " hardening"
DISTROOVERRIDES:append:mx6-generic-bsp = ":hardening"
DISTROOVERRIDES:append:mx6ul-generic-bsp = ":hardening"
DISTROOVERRIDES:append:mx8m-nxp-bsp = ":hardening"
# Deselect some kernel features that aren't always needed in ampliphy- secure
KERNEL_FEATURES_DESELECT ?= "debug kvm media xen"

# File system encryption
DISTRO_FEATURES += "securestorage"
# possible values: fileauthorenc , fileauthandenc
SECURE_STORAGE_TYPE ??= "fileauthandenc"
DISTROOVERRIDES:append = ":securestorage:${SECURE_STORAGE_TYPE}"

#add class secureboot for signing Bootloader and FIT-Image
INHERIT += "secureboot"

# Sign phytec fitImage
FITIMAGE_SIGN ?= "true"

# Sign kernel fitImage
UBOOT_SIGN_ENABLE:mx8m-nxp-bsp = "1"
```
